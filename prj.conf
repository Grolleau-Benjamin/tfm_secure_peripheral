## CMakeLists.txt
```
# Copyright (c) 2026 CATIE
# SPDX-License-Identifier: Apache-2.0

cmake_minimum_required(VERSION 3.20.0)

find_package(Zephyr REQUIRED HINTS $ENV{ZEPHYR_BASE})

get_target_property(TFM_BINARY_DIR tfm TFM_BINARY_DIR)
configure_file(
  ${CMAKE_CURRENT_LIST_DIR}/led_partition/tfm_manifest_list.yaml.in
  ${CMAKE_CURRENT_BINARY_DIR}/led_partition/tfm_manifest_list.yaml
)

if(CONFIG_TFM_IPC)
    set(SPM_BACKEND "IPC")
else()
    set(SPM_BACKEND "SFN")
endif()

configure_file(
  ${CMAKE_CURRENT_LIST_DIR}/led_partition/tfm_led_partition.yaml.in
  ${CMAKE_CURRENT_BINARY_DIR}/led_partition/tfm_led_partition.yaml
)

set_property(TARGET zephyr_property_target
  APPEND PROPERTY TFM_CMAKE_OPTIONS
  -DTFM_EXTRA_MANIFEST_LIST_FILES=${CMAKE_CURRENT_BINARY_DIR}/led_partition/tfm_manifest_list.yaml
  -DTFM_EXTRA_PARTITION_PATHS=${CMAKE_CURRENT_LIST_DIR}/led_partition
)

project(tfm_led_partition)

target_sources(app PRIVATE
  src/main.c
  src/led_partition.c
)

target_include_directories(app PRIVATE
  $<TARGET_PROPERTY:tfm,TFM_BINARY_DIR>/api_ns/interface/include
)

target_compile_definitions(app
    PRIVATE TFM_PARTITION_LED_PARTITION
)
```

## sample.yaml
```
sample:
  name: TF-M LED Secure Partition
common:
  tags:
    - trusted-firmware-m
    - mcuboot
  platform_allow:
    - b_u585i_iot02a/stm32u585xx/ns
  harness: console
  harness_config:
    type: one_line
    regex:
      - "NSPE: toggling secure LED"
tests:
  sample.tfm.led_partition.ipc:
    extra_configs:
      - CONFIG_TFM_IPC=y
```

## prj.conf
```kconfig
# Copyright (c) 2026 CATIE
# SPDX-License-Identifier: Apache-2.0

CONFIG_BUILD_WITH_TFM=y
CONFIG_TFM_PROFILE_TYPE_NOT_SET=y
CONFIG_TFM_CONNECTION_BASED_SERVICE_API=y

CONFIG_TFM_IPC=y

CONFIG_TFM_ISOLATION_LEVEL=1
```

## app.overlay
```dts
/*
 * Copyright (c) 2026 CATIE
 *
 * SPDX-License-Identifier: Apache-2.0
 */

&{/leds} {
    status = "disabled";
};
```

## src/main.c
```c
/*
 * Copyright (c) 2026, CATIE
 * SPDX-License-Identifier: Apache-2.0
 */

#include <zephyr/kernel.h>
#include <tfm_ns_interface.h>

#include "led_partition.h"

int main(void)
{
    printk("NSPE: toggling secure LED (LD7/PH7) via TF-M partition\n");

    while (1)
    {
        psa_status_t status = lp_led_toggle();

        if (status != PSA_SUCCESS)
        {
            printk("lp_led_toggle failed: %d\n", status);
        }

        k_sleep(K_MSEC(500));
    }

    return 0;
}
```

## src/led_partition.c
```c
/*
 * Copyright (c) 2026, CATIE
 * SPDX-License-Identifier: Apache-2.0
 */

#include <tfm_ns_interface.h>

#include "led_partition.h"

#include "psa/client.h"
#include "psa_manifest/sid.h"

psa_status_t lp_led_toggle(void)
{
    psa_status_t status;
    psa_handle_t handle;

    handle = psa_connect(TFM_LP_LED_TOGGLE_SID,
                         TFM_LP_LED_TOGGLE_VERSION);
    if (!PSA_HANDLE_IS_VALID(handle))
    {
        return PSA_ERROR_GENERIC_ERROR;
    }

    /* No payload: the toggle takes no input and returns no output. */
    status = psa_call(handle, PSA_IPC_CALL, NULL, 0, NULL, 0);

    psa_close(handle);

    return status;
}
```

## src/led_partition.h
```c
/*
 * Copyright (c) 2026, CATIE
 * SPDX-License-Identifier: Apache-2.0
 */

psa_status_t lp_led_toggle(void);
```
